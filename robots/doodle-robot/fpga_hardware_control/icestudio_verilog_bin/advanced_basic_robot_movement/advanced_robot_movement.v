// Code generated by Icestudio 0.3.1-rc
// Tue, 31 Oct 2017 11:37:00 GMT

`default_nettype none

module main #(
 parameter v275834 = 80_000_000,
 parameter v15278c = 12_000_000,
 parameter v77874e = 75,
 parameter vd6e0a6 = 63,
 parameter v8a0d75 = 120,
 parameter vbfa150 = 200,
 parameter v48f44c = 171,
 parameter v5e4ec8 = 100,
 parameter v6dc2ee = 110,
 parameter vaa573c = 127
) (
 input vclk,
 output v319115,
 output v4013e7,
 output v8357d7,
 output v862850,
 output v801fdb,
 output v2d75c7,
 output v6108bc,
 output v00cca0,
 output va5e6e7,
 output vf4f128,
 output v500393
);
 localparam p2 = v77874e;
 localparam p3 = vbfa150;
 localparam p7 = vaa573c;
 localparam p8 = v48f44c;
 localparam p9 = vd6e0a6;
 localparam p11 = vaa573c;
 localparam p14 = v5e4ec8;
 localparam p15 = v8a0d75;
 localparam p16 = v6dc2ee;
 localparam p21 = v15278c;
 localparam p23 = v275834;
 wire w0;
 wire w1;
 wire w4;
 wire w5;
 wire w6;
 wire w10;
 wire w12;
 wire w13;
 wire w17;
 wire w18;
 wire w19;
 wire w20;
 wire w22;
 wire w24;
 wire w25;
 wire w26;
 wire w27;
 wire w28;
 wire w29;
 wire w30;
 wire w31;
 wire w32;
 wire w33;
 wire w34;
 wire w35;
 wire w36;
 wire w37;
 assign v319115 = w6;
 assign v4013e7 = w10;
 assign v8357d7 = w17;
 assign v862850 = w25;
 assign v2d75c7 = w26;
 assign v00cca0 = w27;
 assign vf4f128 = w28;
 assign v801fdb = w29;
 assign v6108bc = w30;
 assign va5e6e7 = w31;
 assign v500393 = w32;
 assign w33 = vclk;
 assign w34 = vclk;
 assign w35 = vclk;
 assign w36 = vclk;
 assign w37 = vclk;
 assign w4 = w1;
 assign w5 = w0;
 assign w12 = w1;
 assign w12 = w4;
 assign w13 = w0;
 assign w13 = w5;
 assign w18 = w1;
 assign w18 = w4;
 assign w18 = w12;
 assign w19 = w0;
 assign w19 = w5;
 assign w19 = w13;
 assign w26 = w25;
 assign w27 = w25;
 assign w27 = w26;
 assign w28 = w25;
 assign w28 = w26;
 assign w28 = w27;
 assign w29 = w1;
 assign w29 = w4;
 assign w29 = w12;
 assign w29 = w18;
 assign w30 = w1;
 assign w30 = w4;
 assign w30 = w12;
 assign w30 = w18;
 assign w30 = w29;
 assign w31 = w1;
 assign w31 = w4;
 assign w31 = w12;
 assign w31 = w18;
 assign w31 = w29;
 assign w31 = w30;
 assign w32 = w1;
 assign w32 = w4;
 assign w32 = w12;
 assign w32 = w18;
 assign w32 = w29;
 assign w32 = w30;
 assign w32 = w31;
 assign w34 = w33;
 assign w35 = w33;
 assign w35 = w34;
 assign w36 = w33;
 assign w36 = w34;
 assign w36 = w35;
 assign w37 = w33;
 assign w37 = w34;
 assign w37 = w35;
 assign w37 = w36;
 v32200d vd45f2a (
  .v0e28cb(w1),
  .vcbab45(w25)
 );
 v70ff7f vc69fb4 (
  .vc24d9f(w0),
  .vef4cea(w20),
  .vb55943(w24)
 );
 v3e6c24 v02bc91 (
  .v608bd9(w20)
 );
 v11a6f4 v0016ad (
  .v3ca442(w0),
  .vcbab45(w1),
  .v0e28cb(w22)
 );
 vb65c25 #(
  .v79a04d(p2),
  .v65ff05(p3),
  .vc78345(p7)
 ) vda8572 (
  .ve40401(w4),
  .v4e3a3a(w5),
  .v8aec2f(w6),
  .v8c732a(w33)
 );
 vb65c25 #(
  .v65ff05(p8),
  .v79a04d(p9),
  .vc78345(p11)
 ) v7ef3c3 (
  .v8aec2f(w10),
  .ve40401(w12),
  .v4e3a3a(w13),
  .v8c732a(w34)
 );
 vb65c25 #(
  .v65ff05(p14),
  .v79a04d(p15),
  .vc78345(p16)
 ) v9590d4 (
  .v8aec2f(w17),
  .ve40401(w18),
  .v4e3a3a(w19),
  .v8c732a(w35)
 );
 v2003b1 #(
  .veca477(p21)
 ) v88c42a (
  .v22d3e8(w22),
  .vc04c2e(w36)
 );
 v2003b1 #(
  .veca477(p23)
 ) v9b05a6 (
  .v22d3e8(w24),
  .vc04c2e(w37)
 );
endmodule

module v32200d (
 input v0e28cb,
 output vcbab45
);
 wire w0;
 wire w1;
 assign w0 = v0e28cb;
 assign vcbab45 = w1;
 v32200d_vd54ca1 vd54ca1 (
  .a(w0),
  .c(w1)
 );
endmodule

module v32200d_vd54ca1 (
 input a,
 output c
);
 // NOT logic gate
 
 assign c = ~ a;
endmodule

module v70ff7f (
 input vb55943,
 input vef4cea,
 output vc24d9f
);
 wire w0;
 wire w1;
 wire w2;
 assign w0 = vef4cea;
 assign w1 = vb55943;
 assign vc24d9f = w2;
 v70ff7f_v526aa2 v526aa2 (
  .d(w0),
  .clk(w1),
  .q(w2)
 );
endmodule

module v70ff7f_v526aa2 (
 input clk,
 input d,
 output q
);
 // D flip-flop
 
 reg q = 1'b0;
 
 always @(posedge clk)
 begin
   q <= d;
 end
 
 
endmodule

module v3e6c24 (
 output v608bd9
);
 wire w0;
 assign v608bd9 = w0;
 v3e6c24_v68c173 v68c173 (
  .v(w0)
 );
endmodule

module v3e6c24_v68c173 (
 output v
);
 // Bit 1
 
 assign v = 1'b1;
endmodule

module v11a6f4 (
 input v0e28cb,
 input v3ca442,
 output vcbab45
);
 wire w0;
 wire w1;
 wire w2;
 assign w0 = v0e28cb;
 assign w1 = v3ca442;
 assign vcbab45 = w2;
 v11a6f4_vf4938a vf4938a (
  .a(w0),
  .b(w1),
  .c(w2)
 );
endmodule

module v11a6f4_vf4938a (
 input a,
 input b,
 output c
);
 // AND logic gate
 
 assign c = a & b;
endmodule

module vb65c25 #(
 parameter v79a04d = 8'h39,
 parameter v65ff05 = 8'hAB,
 parameter vc78345 = 8'h72
) (
 input v8c732a,
 input ve40401,
 input v4e3a3a,
 output v8aec2f
);
 localparam p1 = v65ff05;
 localparam p3 = v79a04d;
 localparam p4 = vc78345;
 wire w0;
 wire w2;
 wire w5;
 wire w6;
 assign v8aec2f = w0;
 assign w2 = ve40401;
 assign w5 = v4e3a3a;
 assign w6 = v8c732a;
 vb65c25_v815aa1 #(
  .in_max_angle(p1),
  .in_min_angle(p3),
  .in_home_pos(p4)
 ) v815aa1 (
  .servo(w0),
  .bitpos(w2),
  .enable_mov(w5),
  .clk(w6)
 );
endmodule

module vb65c25_v815aa1 #(
 parameter in_min_angle = 0,
 parameter in_max_angle = 0,
 parameter in_home_pos = 0
) (
 input clk,
 input bitpos,
 input enable_mov,
 output servo
);
 //-- ServoBit-180
 
 //-- Control de un servo Futaba 3003
 //-- con un bit. Se mueve a dos posiciones
 //-- Si enable movement está 0, el servo se mantiene en la posición "home_pos"
 //-- que se corresonden con 0 / 1
 //-- El angulo total recorrido es de 180 grados
 
 //-- ENTRADAS:
 //--  clk: Señal del sistema (12Mhz)
 //--  bitpos: Bit de posicion (0 - posicion derecha, 1 - posicion izquierda)
      
 //   Bitpos 0   Bitpos 1
 //    ___          ___
 //   | o---->  <----o |
 //   |   |        |   |
 //   |___|        |___|
 
 //-- SALIDAS:
 //-- servo : Señal PWM para controlar el servo
 
 //-- Constantes para el angulo DEL servo
 localparam ANG_0   = 8'h01;
 localparam ANG_45=8'h39;
 localparam ANG_90 = 8'h5F;
 localparam ANG_135=8'hAB;
 localparam ANG_180=8'hE0;
 localparam ANG_120=8'h5F;
 
 parameter min_angle =in_min_angle;
 parameter max_angle =in_max_angle;
 parameter home_pos=in_home_pos;
 
 //-- Posicion del servo cuando el
 //-- bit de entrada es 0
 //-- La corona del servo mira a la derecha
 localparam BIT0 = min_angle;
 
 //-- Posicion el servo cuando el BIT
 //-- de entrada es 1
 //-- La corona del servo mira a la izquierda
 localparam BIT1 = max_angle;
 
 //--Posicion del servo neutra o home
 localparam BITH=home_pos;
 
 
 //-- Posicion de 8 bits del servo
 reg [7:0] pos;
 
 //-- Asignar la posicion de 8 bits
 //-- segun si lo recibido es 0 ó 1 o segun si el enable_mov está activado
 always @(posedge clk)
   begin//pos <= bitpos ? BIT1 : BIT0;
     if (enable_mov ==0)
        pos<=BITH;
     else if (bitpos==0)
        pos<=BIT0;
     else
        pos<=BIT1;
   end
 //---
 //--- ServoMotor 
 
 //-- M es el valor del divisor para
 //-- obtener tics de M / 12.0 micro-segundos
 localparam M = 94; 
 localparam N = $clog2(M);
 
 //-- Contador para generar los tics
 reg [N-1:0] divcounter = 0;
 
 //-- Flag para indicar que un tic
 //-- ha ocurrido
 reg tic = 0;
 
 //-- Generacion de los tics. Cada
 //-- M ciclos del reloj se genera 1
 always @(posedge clk)
  tic <= (divcounter == M - 2);
 
 //-- Contador modulo M
 always @(posedge clk)
  if (tic)
    divcounter <= 0;
  else
    divcounter <= divcounter + 1;
 
 //-- Contador de la posicion del 
 //-- servo
 reg [10:0] angle_counter = 0;
 
 //-- A la posicion destino hay que
 //-- sumarle un offset, correspondiente
 //-- a los 0.3ms de la posicion inicial
 wire [8:0] pose = {1'b0, pos} + 9'd46;
 
 //-- Con cada tic se incrementa el
 //-- contador de angulo del servo
 always @(posedge clk)
  if (tic)
    angle_counter <= angle_counter + 1;
 
 //-- Cuando el contador es menor que el 
 //-- valor objetivo, la señal de PWM
 //-- del servo se pone 1, y 0 en 
 //-- caso contrario
 
 reg servo;
 
 always @(posedge clk) begin
  servo <= (angle_counter < {2'b00, pose});
  end
 
 
 
 
endmodule

module v2003b1 #(
 parameter veca477 = 12_000_000
) (
 input vc04c2e,
 output v22d3e8
);
 localparam p2 = veca477;
 wire w0;
 wire w1;
 assign w0 = vc04c2e;
 assign v22d3e8 = w1;
 v2003b1_v3805f2 #(
  .M_in(p2)
 ) v3805f2 (
  .clk(w0),
  .clk_out(w1)
 );
endmodule

module v2003b1_v3805f2 #(
 parameter M_in = 0
) (
 input clk,
 output clk_out
);
 //-- module bomba_x1(input wire clk, output wire clk_1hz)
 
 //-- Bombeo de bits de periodo regular a X Hz (Dictado por M y N)
 
 //-- Constante para dividir y obtener una frecuencia de  X Hz
 parameter M = M_in;
 
 //-- Calcular el numero de bits para almacenar M
 localparam N = $clog2(M);
 
 //-- Registro del divisor
 reg [N-1:0] divcounter;
 
 //-- Contador modulo M. tras M pulsos de reloj vuelve a 0
 always @(posedge clk)
   divcounter <= (divcounter == M - 1) ? 0 : divcounter + 1;
 
 //-- Obtener la señal de X Hz. La señal no tiene ciclo del 50%
 wire clk_doublehz;
 assign clk_doublehz = divcounter[N-1]; 
 
 //-- Usamos un biestable T para dividir entre 2 y obtener una señal
 //-- de X Hz y ciclo del 50%
 reg T = 0;
 always @(posedge clk_doublehz)
   T <= ~T;
   
 //-- Señal de salida de 1Hz y ciclo del 50%
 assign clk_out = T;
   
 //endmodule
endmodule
